## sdkconfig.defaults
```kconfig
CONFIG_AUTOSTART_ARDUINO=y
CONFIG_ESPTOOLPY_FLASHSIZE_4MB=y

CONFIG_BT_ENABLED=y
CONFIG_BT_CLASSIC_ENABLED=y
CONFIG_BT_BLE_ENABLED=y 
CONFIG_BT_HID_ENABLED=y
# CONFIG_BT_HID_HOST_ENABLED is not set
CONFIG_BT_HID_DEVICE_ENABLED=y
CONFIG_BT_BLUEDROID_ENABLED=y
CONFIG_BT_SSP_ENABLED=y

CONFIG_BTDM_CTRL_MODE_BR_EDR_ONLY=n
CONFIG_BTDM_CTRL_MODE_BLE_ONLY=n
CONFIG_BTDM_CTRL_MODE_BTDM=y

CONFIG_ESP32_WIFI_SW_COEXIST_ENABLE=y

CONFIG_FREERTOS_HZ=1000
```
